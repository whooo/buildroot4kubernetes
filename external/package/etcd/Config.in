## external/package/etcd/Config.in
```kconfig
config BR2_PACKAGE_ETCD
	bool "etcd"
	depends on BR2_PACKAGE_HOST_GO_TARGET_ARCH_SUPPORTS
	help
	  ectd
```

## external/package/kubernetes/Config.in
```kconfig
config BR2_PACKAGE_KUBERNETES
	bool "kubernetes"
	help
	  Production-Grade Container Orchestration

	  https://kubernetes.io/

if BR2_PACKAGE_KUBERNETES

config BR2_PACKAGE_KUBERNETES_KUBELET
	bool "kubernetes kubelet"
	help
	  Production-Grade Container Orchestration

	  kubelet package

config BR2_PACKAGE_KUBERNETES_KUBE_APISERVER
	bool "kubernetes kube-apiserver"
	help
	  Production-Grade Container Orchestration

	  kube-apiserver package

config BR2_PACKAGE_KUBERNETES_KUBE_CONTROLLER_MANAGER
	bool "kubernetes kube-controller-manager"
	help
	  Production-Grade Container Orchestration

	  kube-controller-manager package

config BR2_PACKAGE_KUBERNETES_KUBE_SCHEDULER
	bool "kubernetes kube-scheduler"
	help
	  Production-Grade Container Orchestration

	  kube-scheduler package

config BR2_PACKAGE_KUBERNETES_KUBE_PROXY
	bool "kubernetes kube-proxy"
	help
	  Production-Grade Container Orchestration

	  kube-proxy package

config BR2_PACKAGE_KUBERNETES_KUBECTL
	bool "kubernetes kubectl"
	help
	  Production-Grade Container Orchestration

	  kubectl package

config BR2_PACKAGE_KUBERNETES_KUBEADM
	bool "kubernetes kubeadm"
	help
	  Production-Grade Container Orchestration

	  kubeadm package

endif
```

## external/package/kubernetes/Config.in.host
```kconfig
config BR2_PACKAGE_HOST_KUBERNETES
	bool "host kubernetes"
	help
	  Production-Grade Container Orchestration

	  host packages

if BR2_PACKAGE_HOST_KUBERNETES

config BR2_PACKAGE_HOST_KUBERNETES_KUBEADM
        bool "host kubernetes-kubeadm"
        help
          Production-Grade Container Orchestration

	  kubeadm host package

endif
```

## external/package/skopeo/Config.in.host
```kconfig
config BR2_PACKAGE_HOST_SKOPEO
	bool "host skopeo"
	depends on BR2_PACKAGE_HOST_GO_TARGET_ARCH_SUPPORTS
	help
	  host skopeo
```
